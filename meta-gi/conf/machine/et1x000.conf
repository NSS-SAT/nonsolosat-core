## meta-gi/conf/machine/et1x000.conf
```bitbake
#@TYPE: Machine
#@NAME: Galaxy Innovations ET11000
#@DESCRIPTION: Machine configuration for the Galaxy Innovations ET11000

MACHINE_FEATURES += " textlcd 7segment dvb-c nextv-blindscan-dvbc mmc nextv-cortexa15"
OPENPLI_FEATURES += " ci kodi"
DISTRO_FEATURES_remove = "x11 wayland directfb"

CHIPSET = "bcm7251s"

KERNEL_FILE = "kernel.bin"
ROOTFS_FILE = "rootfs.tar.bz2"

PREFERRED_VERSION_linux-nextv = "4.1.37"
require conf/machine/include/nextv-arm.inc
```

## meta-miraclebox/conf/layer.conf
```bitbake
# We have a conf and classes directory, append to BBPATH
BBPATH .= ":${LAYERDIR}"

BBFILES += "${LAYERDIR}/recipes-*/*/*.bb"

DISTRO_NAME = "nonsolosat"
DISTRO_HOST = "nonsolosat.net"
```

## meta-miraclebox/conf/machine/mbminiplus.conf
```bitbake
#@TYPE: Machine
#@NAME: Miraclebox
#@DESCRIPTION: Machine configuration for the Miraclebox Premium Mini Plus

require conf/machine/include/miraclebox.inc

IMAGEDIR ?= "miraclebox/miniplus"

MACHINE_BRAND = "Miraclebox"
MACHINE_NAME = "Premium Mini PLUS"
MACHINEBUILD = "mbminiplus"
MACHINE_OEM = "inihde2"

PREFERRED_VERSION_linux-${MACHINE} = "3.14.2"

MKUBIFS_ARGS = "-m 2048 -e 126976 -c 4096"
UBINIZE_ARGS = "-m 2048 -p 128KiB"

MACHINE_FEATURES += " textlcd ci dvb-c blindscan-dvbc blindscan-dvbs extrasplash"

CHIPSET = "bcm7362"
```

## meta-qviart/conf/machine/dual.conf
```bitbake
#@TYPE: Machine
#@NAME: dual
#@DESCRIPTION: Machine configuration for the dual

SOC_FAMILY = "hisi3798mv200"

EXTRA_OECONF_append_pn-enigma2 = "--with-lcddev=/dev/null --with-alphablendingacceleration=always --with-blitaccelerationthreshold=250  --with-fillaccelerationthreshold=190000"

MACHINE_FEATURES += " textlcd 7segment blindscan dvb-c hisil mali transcoding emmc fastboot"
DISTRO_FEATURES_remove = "x11 wayland"
OPENPLI_FEATURES += "kodi"

require conf/machine/include/qviart-hisi.inc

KV = "linux-4.4.35"

PREFERRED_VERSION_linux-qviart = "4.4.35"
```

## meta-qviart/conf/machine/lunix4k.conf
```bitbake
#@TYPE: Machine
#@NAME: qviart lunix 4k (72604)
#@DESCRIPTION: Machine configuration for the lunix 4k.
#

CHIP = "72604"

UPDATE_DIR = "lunix4k"

require conf/machine/include/qviart4k.inc

MACHINE_FEATURES += "blindscan-dvbs proxy nextv-cortexa15 swap dvb-c textlcd"
OPENPLI_FEATURES += "kodi"

KV = "linux-4.1.20"

CHIPSET = "bcm72604"

FORCE_REBOOT_OPTION = "reboot"

MACHINE_KERNEL_PR = "r1"

IMAGE_FSTYPES =+ "ext4"

PREFERRED_VERSION_linux-qviart = "4.1.20"

PREFERRED_PROVIDER_virtual/egl = "v3d-libgles-${CHIP}" 
PREFERRED_PROVIDER_virtual/libgles2 = "v3d-libgles-${CHIP}"
PREFERRED_PROVIDER_virtual/blindscan-dvbs = "qviart-blindscan-utils-${CHIP}"

MACHINE_ESSENTIAL_EXTRA_RDEPENDS += " \
	${@bb.utils.contains("MACHINE_FEATURES", "proxy", "platform-util-${CHIP} qviart-dvb-modules-proxy${CHIP}", "", d)} \
	${@bb.utils.contains("MACHINE_FEATURES", "nextv-cortexa15", "v3d-libgles-${CHIP}","", d)} \
	${@bb.utils.contains("MACHINE_FEATURES", "swap", "swapcreate-${CHIP}", "", d)} \
	${@bb.utils.contains("MACHINE_FEATURES", "blindscan-dvbs", "qviart-blindscan-utils-${CHIP}", "", d)} \
"
```

## meta-uclan/conf/machine/ustym4kpro.conf
```bitbake
#@TYPE: Machine
#@NAME: ustym4kpro
#@DESCRIPTION: Machine configuration for the ustym4kpro

EXTRA_OECONF_append_pn-enigma2 = "--with-lcddev=/dev/null --with-alphablendingacceleration=always --with-blitaccelerationthreshold=250  --with-fillaccelerationthreshold=190000"

MACHINE_FEATURES += " textlcd 7segment blindscan dvb-c hisil mali transcoding emmc"
OPENPLI_FEATURES += " qtplugins kodi openhbbtvbrowser"
DISTRO_FEATURES_remove = "x11 wayland"

CHIPSET = "Hi3798Mv200"

require conf/machine/include/uclan-hisi.inc
```

## meta-uclan/conf/machine/ustym4ks2ottx.conf
```bitbake
#@TYPE: Machine
#@NAME: ustym4ks2ottx
#@DESCRIPTION: Machine configuration for the ustym4ks2ottx

EXTRA_OECONF_append_pn-enigma2 = "--with-lcddev=/dev/null --with-alphablendingacceleration=always --with-blitaccelerationthreshold=250  --with-fillaccelerationthreshold=190000"

MACHINE_FEATURES += " textlcd 7segment blindscan hisil mali transcoding emmc"
OPENPLI_FEATURES += " qtplugins kodi openhbbtvbrowser"
DISTRO_FEATURES_remove = "x11 wayland"

CHIPSET = "Hi3798Mv300"


require conf/machine/include/uclan-hisi-3798mv300.inc
```

## meta-xpeedc/conf/machine/xpeedc.conf
```bitbake
#@TYPE: Machine
#@NAME: xpeedc
#@DESCRIPTION: Machine configuration for the xpeedc

MACHINE_FEATURES += " textlcd dvb-c xpeedc-nextv-blindscan-dvbc"
DISTRO_FEATURES_remove = "x11 wayland directfb"

MKUBIFS_ARGS = "-m 2048 -e 126976 -c 8192"
UBINIZE_ARGS = "-m 2048 -p 128KiB"

CHIPSET = "bcm7362"

PREFERRED_VERSION_linux-xpeedc-nextv = "4.1.21"
require conf/machine/include/xpeedc-nextv-mipsel.inc
```

## meta-xtrend/conf/machine/et5x00.conf
```bitbake
#@TYPE: Machine
#@NAME: Xtrend et5x00
#@DESCRIPTION: Machine configuration for the Xtrend et5x00

MKUBIFS_ARGS = "-m 2048 -e 126976 -c 4096"
UBINIZE_ARGS = "-m 2048 -p 128KiB"

MACHINE_FEATURES += " micom"
DISTRO_FEATURES_remove = "x11 wayland directfb blindscan-dvbs"

CHIPSET = "bcm7413"
RCTYPE = "7"

PREFERRED_PROVIDER_virtual/blindscan-dvbs = "et-blindscan-dvbs-utils"
PREFERRED_VERSION_linux-et = "3.8.7"
require conf/machine/include/et-mipsel.inc
```

## meta-xtrend/conf/machine/et8500.conf
```bitbake
#@TYPE: Machine
#@NAME: et8500
#@DESCRIPTION: Machine configuration for the et8500

MACHINE_FEATURES += " dvb-c et-nextv-blindscan-dvbc"
OPENPLI_FEATURES += " ci"
DISTRO_FEATURES_remove = "x11 wayland directfb"

MKUBIFS_ARGS = "-m 2048 -e 126976 -c 8192"
UBINIZE_ARGS = "-m 2048 -p 128KiB"

CHIPSET = "bcm7241"

PREFERRED_VERSION_linux-et-nextv = "4.4.8"
require conf/machine/include/et-nextv-mipsel.inc
```

## meta-xtrend/conf/machine/et9x00.conf
```bitbake
#@TYPE: Machine
#@NAME: Xtrend et9x00
#@DESCRIPTION: Machine configuration for the Xtrend et9x00

MKUBIFS_ARGS = "-m 2048 -e 126976 -c 4096"
UBINIZE_ARGS = "-m 2048 -p 128KiB"

MACHINE_FEATURES += " micom textlcd blindscan-dvbs"
DISTRO_FEATURES_remove = "x11 wayland directfb"

CHIPSET = "bcm7413"
RCTYPE = "9"

PREFERRED_PROVIDER_virtual/blindscan-dvbs = "et-blindscan-dvbs-utils"
PREFERRED_VERSION_linux-et = "3.8.7"
require conf/machine/include/et-mipsel.inc
```
